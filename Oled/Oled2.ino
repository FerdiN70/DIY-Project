#define BLYNK_TEMPLATE_ID "TMPL6t7wKzUYm"
#define BLYNK_TEMPLATE_NAME "IOT Ferdi"
#define BLYNK_AUTH_TOKEN "WORWf2qeTrDMfuNNC_BrCNUJKlo04f36"

#define BLYNK_PRINT Serial
#include <BlynkSimpleEsp8266.h>
#include <ESP8266HTTPClient.h>
#include <WiFiClientSecure.h>
#include <ArduinoJson.h>
#include <WiFiUdp.h>
#include <NTPClient.h>
#include <Wire.h>
#include <Adafruit_GFX.h>
#include <Adafruit_SSD1306.h>
#include <time.h>
#include <Servo.h>

// --- KONFIGURASI WI-FI ---
const char* ssid = "Modemku";
const char* password = "Ferdi1234";

// --- KOORDINAT LOKASI ---
const float LATITUDE = -6.2088;
const float LONGITUDE = 106.8456;

// --- KONFIGURASI PIN ---
#define SCREEN_WIDTH 128
#define SCREEN_HEIGHT 64
#define OLED_SDA D2
#define OLED_SCL D1
#define BUTTON_PIN D3

#define TRIG_PIN D5
#define ECHO_PIN D6
#define SERVO_PIN D7

Adafruit_SSD1306 display(SCREEN_WIDTH, SCREEN_HEIGHT, &Wire, -1);
Servo portalServo;
BlynkTimer timer;

// --- KONTROL KECEPATAN SERVO & SENSOR ---
int currentServoAngle = 0;
unsigned long lastServoMove = 0;
const int SERVO_SPEED_DELAY = 5;
const int SERVO_STEP = 3;

unsigned long lastSensorRead = 0;
const int SENSOR_INTERVAL = 60;
float lastDistance = 999.0;
bool blynkManualOpen = false;

// --- FUNGSI BLYNK ---
BLYNK_WRITE(V2) {
  int buttonValue = param.asInt();
  blynkManualOpen = (buttonValue == 1);
}

void sendBlynkData() {
  if (lastDistance < 400.0) {
    Blynk.virtualWrite(V0, lastDistance); // Kirim jarak ke V0
  }
  
  if (currentServoAngle == 90) {
    Blynk.virtualWrite(V1, "TERBUKA");    // Kirim status ke V1
  } else {
    Blynk.virtualWrite(V1, "TERTUTUP");
  }
}

// --- KONFIGURASI NTP CLIENT ---
const long utcOffsetInSeconds = 25200;
WiFiUDP ntpUDP;
NTPClient timeClient(ntpUDP, "pool.ntp.org", utcOffsetInSeconds);

const char* daysOfWeek[7] = { "Minggu", "Senin", "Selasa", "Rabu", "Kamis", "Jumat", "Sabtu" };

int weatherCode = -1;
unsigned long lastWeatherCheck = 0;
const unsigned long weatherInterval = 900000;

enum DisplayMode { CLOCK_MODE, EMOJI_MODE };
DisplayMode currentMode = CLOCK_MODE;

bool lastButtonState = HIGH;
unsigned long buttonPressTime = 0;
bool isHolding = false;

// --- TIMING DISPLAY NON-BLOCKING ---
unsigned long lastDisplayUpdate = 0;

// --- ANIMASI BITMAP DATA ---
#define FRAME_DELAY (42)

#define FRAME_WIDTH_1 (48)
#define FRAME_HEIGHT_1 (48)
const byte PROGMEM frames1[][288] = {
  {0,0,0,0,0,0,0,0,0,0,0,0,0,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0,0},
  {0,0,0,0,0,0,0,0,0,0,0,0,0,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0,0},
  {0,0,0,0,0,0,0,0,0,0,0,0,0,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0,0},
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  {0,0,0,0,0,0,0,0,0,0,0,0,0,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0,0}
};

#define FRAME_WIDTH_2 (48)
#define FRAME_HEIGHT_2 (48)
const byte PROGMEM frames2[][288] = {
 {0,0,0,0,0,0,0,0,0,0,0,0,0,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0,0},
  {0,0,0,0,0,0,0,0,0,0,0,0,0,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0,0},
  {0,0,0,0,0,0,0,0,0,0,0,0,0,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0,0},
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  {0,0,0,0,0,0,0,0,0,0,0,0,0,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0,0}
};

#define FRAME_WIDTH_3 (48)
#define FRAME_HEIGHT_3 (48)
const byte PROGMEM frames3[][288] = {
 {0,0,0,0,0,0,0,0,1,128,0,0,0,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0,0},
  {0,0,0,0,0,0,0,0,1,128,0,0,0,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0,0},
  {0,0,0,0,0,0,0,0,1,128,0,0,0,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0,0},
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  {0,0,0,0,0,0,0,0,1,128,0,0,0,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0,0}
};

int currentAnimIndex = 0;
int currentAnimationFrame = 0;

void drawSunIcon(int x, int y) {
  display.drawCircle(x, y, 5, SSD1306_WHITE);
  display.drawLine(x, y - 8, x, y - 6, SSD1306_WHITE);
  display.drawLine(x, y + 6, x, y + 8, SSD1306_WHITE);
  display.drawLine(x - 8, y, x - 6, y, SSD1306_WHITE);
  display.drawLine(x + 6, y, x + 8, y, SSD1306_WHITE);
}

void drawCloudyIcon(int x, int y) {
  display.drawCircle(x - 3, y - 3, 4, SSD1306_WHITE);
  display.fillCircle(x, y + 2, 4, SSD1306_WHITE);
  display.fillCircle(x + 5, y, 5, SSD1306_WHITE);
  display.fillCircle(x + 10, y + 2, 3, SSD1306_WHITE);
  display.fillRect(x, y + 3, 11, 3, SSD1306_WHITE);
}

void drawOvercastIcon(int x, int y) {
  display.fillCircle(x - 5, y + 2, 5, SSD1306_WHITE);
  display.fillCircle(x, y - 1, 6, SSD1306_WHITE);
  display.fillCircle(x + 6, y + 2, 4, SSD1306_WHITE);
  display.fillRect(x - 5, y + 3, 12, 4, SSD1306_WHITE);
}

void drawRainIcon(int x, int y) {
  drawOvercastIcon(x, y - 2);
  display.drawLine(x - 4, y + 6, x - 5, y + 8, SSD1306_WHITE);
  display.drawLine(x, y + 6, x - 1, y + 8, SSD1306_WHITE);
  display.drawLine(x + 4, y + 6, x + 3, y + 8, SSD1306_WHITE);
}

void showWiFiLoading(const char* wifiName, int progress) {
  display.clearDisplay();
  display.setTextSize(1);
  display.setTextColor(SSD1306_WHITE);
  display.setCursor(15, 5);
  display.print(F("CONNECTING..."));

  display.setCursor(10, 20);
  display.print(F("WiFi: "));
  display.print(wifiName);

  display.drawRect(14, 38, 100, 10, SSD1306_WHITE);
  int fillWidth = map(progress, 0, 100, 0, 96);
  if (fillWidth > 0) display.fillRect(16, 40, fillWidth, 6, SSD1306_WHITE);

  display.setCursor(50, 52);
  display.print(progress);
  display.print(F("%"));
  display.display();
}

void fetchWeatherData() {
  if (WiFi.status() == WL_CONNECTED) {
    WiFiClientSecure client;
    client.setInsecure();

    HTTPClient http;
    String url = "https://api.open-meteo.com/v1/forecast?latitude=" + String(LATITUDE, 4) + "&longitude=" + String(LONGITUDE, 4) + "&current_weather=true";

    http.begin(client, url);
    int httpCode = http.GET();

    if (httpCode > 0) {
      String payload = http.getString();
      StaticJsonDocument<768> doc;
      if (!deserializeJson(doc, payload)) {
        weatherCode = doc["current_weather"]["weathercode"];
      }
    }
    http.end();
  }
}

// --- PEMBACAAN ULTRASONIK ---
float getDistanceFast() {
  digitalWrite(TRIG_PIN, LOW);
  delayMicroseconds(2);
  digitalWrite(TRIG_PIN, HIGH);
  delayMicroseconds(10);
  digitalWrite(TRIG_PIN, LOW);

  long duration = pulseIn(ECHO_PIN, HIGH, 3000); 
  if (duration == 0) return 999.0;
  return (duration * 0.0343) / 2.0;
}

// --- KONTROL PORTAL SERVO ---
void handlePortal() {
  if (millis() - lastSensorRead >= SENSOR_INTERVAL) {
    lastSensorRead = millis();
    lastDistance = getDistanceFast();
  }

  int targetAngle = 0; // Default Tutup
  
  // Buka jika Jarak < 5cm ATAU tombol buka manual dari Blynk aktif
  if ((lastDistance > 0 && lastDistance < 5.0) || blynkManualOpen) {
    targetAngle = 90; // Buka
  } else {
    targetAngle = 0;  // Tutup
  }

  if (millis() - lastServoMove >= SERVO_SPEED_DELAY) {
    lastServoMove = millis();

    if (currentServoAngle < targetAngle) {
      currentServoAngle += SERVO_STEP;
      if (currentServoAngle > targetAngle) currentServoAngle = targetAngle;
      portalServo.write(currentServoAngle);
    } else if (currentServoAngle > targetAngle) {
      currentServoAngle -= SERVO_STEP;
      if (currentServoAngle < targetAngle) currentServoAngle = targetAngle;
      portalServo.write(currentServoAngle);
    }
  }
}

void setup() {
  Serial.begin(115200);

  pinMode(BUTTON_PIN, INPUT_PULLUP);
  pinMode(TRIG_PIN, OUTPUT);
  pinMode(ECHO_PIN, INPUT);

  portalServo.attach(SERVO_PIN);
  portalServo.write(currentServoAngle);

  Wire.begin(OLED_SDA, OLED_SCL);
  if (!display.begin(SSD1306_SWITCHCAPVCC, 0x3C)) {
    for (;;);
  }

  display.setTextWrap(false);
  display.clearDisplay();

  Blynk.begin(BLYNK_AUTH_TOKEN, ssid, password);

  int progress = 0;
  while (WiFi.status() != WL_CONNECTED) {
    showWiFiLoading(ssid, progress);
    progress += 5;
    if (progress > 95) progress = 10;
    delay(200);
  }

  showWiFiLoading(ssid, 100);
  delay(500);

  timeClient.begin();
  fetchWeatherData();

  // Pengiriman data Blynk diset setiap 500 ms
  timer.setInterval(500L, sendBlynkData);
}

void handleButton() {
  bool currentButtonState = digitalRead(BUTTON_PIN);

  if (lastButtonState == HIGH && currentButtonState == LOW) {
    buttonPressTime = millis();
    isHolding = false;
  }

  if (currentButtonState == LOW && !isHolding) {
    if (millis() - buttonPressTime >= 1500) {
      currentMode = CLOCK_MODE;
      isHolding = true;
    }
  }

  if (lastButtonState == LOW && currentButtonState == HIGH) {
    if (!isHolding && (millis() - buttonPressTime < 1500)) {
      if (currentMode == CLOCK_MODE) {
        currentMode = EMOJI_MODE;
        currentAnimIndex = 0;
      } else {
        currentAnimIndex = (currentAnimIndex + 1) % 3;
      }
      currentAnimationFrame = 0;
    }
  }

  lastButtonState = currentButtonState;
}

void renderClockScreen() {
  timeClient.update();

  if (millis() - lastWeatherCheck > weatherInterval || lastWeatherCheck == 0) {
    fetchWeatherData();
    lastWeatherCheck = millis();
  }

  time_t epochTime = timeClient.getEpochTime();
  struct tm* ptm = gmtime((time_t*)&epochTime);

  char hourMinBuffer[6];
  char secBuffer[3];
  char dateBuffer[12];

  sprintf(hourMinBuffer, "%02d:%02d", ptm->tm_hour, ptm->tm_min);
  sprintf(secBuffer, "%02d", ptm->tm_sec);
  sprintf(dateBuffer, "%02d/%02d/%04d", ptm->tm_mday, ptm->tm_mon + 1, ptm->tm_year + 1900);

  int dayIndex = timeClient.getDay();

  display.clearDisplay();

  // Header Jam & Tanggal
  display.setTextSize(1);
  display.setCursor(0, 0);
  display.print(daysOfWeek[dayIndex]);
  display.setCursor(64, 0);
  display.print(dateBuffer);
  display.drawFastHLine(0, 10, 128, SSD1306_WHITE);

  // Jam Utama
  display.setTextSize(3);
  display.setCursor(2, 16);
  display.print(hourMinBuffer);

  // Detik
  display.setTextSize(2);
  display.setCursor(95, 23);
  display.print(secBuffer);

  display.drawFastHLine(0, 42, 128, SSD1306_WHITE);

  // Footer: Menampilkan Info Jarak Ultrasonic / Cuaca
  display.setTextSize(1);
  if (lastDistance < 50.0) {
    display.setCursor(5, 50);
    display.print(F("Jarak: "));
    display.print(lastDistance, 1);
    display.print(F(" cm"));
  } else {
    int iconX = 38, iconY = 53, textX = 58, textY = 50;

    if (weatherCode == 0) {
      drawSunIcon(iconX, iconY);
      display.setCursor(textX, textY);
      display.print("Cerah");
    } else if (weatherCode >= 1 && weatherCode <= 2) {
      drawCloudyIcon(iconX - 5, iconY - 3);
      display.setCursor(textX, textY);
      display.print("Berawan");
    } else if (weatherCode == 3) {
      drawOvercastIcon(iconX, iconY - 3);
      display.setCursor(textX, textY);
      display.print("Mendung");
    } else if (weatherCode >= 51) {
      drawRainIcon(iconX, iconY - 3);
      display.setCursor(textX, textY);
      display.print("Hujan");
    } else {
      display.setCursor(40, textY);
      display.print("Memuat...");
    }
  }
}

void renderEmojiScreen() {
  display.clearDisplay();

  if (currentAnimIndex == 0) {
    int totalFrames = sizeof(frames1) / sizeof(frames1[0]);
    display.drawBitmap(40, 2, frames1[currentAnimationFrame], FRAME_WIDTH_1, FRAME_HEIGHT_1, SSD1306_WHITE);
    currentAnimationFrame = (currentAnimationFrame + 1) % totalFrames;
  } else if (currentAnimIndex == 1) {
    int totalFrames = sizeof(frames2) / sizeof(frames2[0]);
    display.drawBitmap(40, 2, frames2[currentAnimationFrame], FRAME_WIDTH_2, FRAME_HEIGHT_2, SSD1306_WHITE);
    currentAnimationFrame = (currentAnimationFrame + 1) % totalFrames;
  } else if (currentAnimIndex == 2) {
    int totalFrames = sizeof(frames3) / sizeof(frames3[0]);
    display.drawBitmap(40, 2, frames3[currentAnimationFrame], FRAME_WIDTH_3, FRAME_HEIGHT_3, SSD1306_WHITE);
    currentAnimationFrame = (currentAnimationFrame + 1) % totalFrames;
  }

  // Tampilkan Jarak di Bagian Bawah Layar Animasi
  display.setTextSize(1);
  display.setCursor(5, 54);
  if (lastDistance < 50.0) {
    display.print(F("Jarak: "));
    display.print(lastDistance, 1);
    display.print(F(" cm"));
  } else {
    display.print(F("Jarak: -- cm"));
  }
}

void loop() {
  Blynk.run();
  timer.run();
  handleButton();
  handlePortal();

  if (currentMode == CLOCK_MODE) {
    if (millis() - lastDisplayUpdate >= 100) {
      lastDisplayUpdate = millis();
      renderClockScreen();
      display.display();
    }
  } else {
    if (millis() - lastDisplayUpdate >= FRAME_DELAY) {
      lastDisplayUpdate = millis();
      renderEmojiScreen();
      display.display();
    }
  }
}